## sdkconfig.defaults
```kconfig
# CarDash Monitor — sdkconfig.defaults
# These settings are applied automatically on first build.

# WiFi
CONFIG_ESP_WIFI_SOFTAP_SUPPORT=y

# HTTP server — bump max open sockets for multiple browser tabs
CONFIG_HTTPD_MAX_REQ_HDR_LEN=1024
CONFIG_HTTPD_MAX_URI_LEN=512
CONFIG_HTTPD_MAX_RESP_HEADERS=8

# Increase main task stack for safety
CONFIG_ESP_MAIN_TASK_STACK_SIZE=8192

# NVS
CONFIG_NVS_ASSERT_ERROR_CHECK=n

# Logging level (set to INFO; change to DEBUG for verbose AT output)
CONFIG_LOG_DEFAULT_LEVEL_INFO=y
```
